## config/west.yml
```yaml
manifest:
  remotes:
    - name: zmkfirmware
      url-base: https://github.com/zmkfirmware
    - name: petejohanson
      url-base: https://github.com/petejohanson
    # Additional modules containing boards/shields/custom code can be listed here as well
    # See https://docs.zephyrproject.org/3.2.0/develop/west/manifest.html#projects
  projects:
    - name: zmk
      remote: petejohanson
      revision: core/zephyr-3.5-update
      clone-depth: 1
      import: app/west.yml
    - name: le-capybara-zmk-module
      remote: petejohanson
      clone-depth: 1
      revision: zephyr-3.5-update
  self:
    path: config
```
